## config/boards/shields/Ribera/Kconfig.defconfig
```kconfig
if SHIELD_RIBERA_LEFT

config ZMK_KEYBOARD_NAME
    default "Ribera"

config ZMK_SPLIT_ROLE_CENTRAL
    default y

endif

if SHIELD_RIBERA_LEFT || SHIELD_RIBERA_RIGHT

config ZMK_SPLIT
    default y

endif
```

## config/boards/shields/Ribera/Kconfig.shield
```kconfig
config SHIELD_RIBERA_LEFT
    def_bool $(shields_list_contains,ribera_left)

config SHIELD_RIBERA_RIGHT
    def_bool $(shields_list_contains,ribera_right)
```
