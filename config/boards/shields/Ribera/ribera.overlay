#include <dt-bindings/zmk/matrix_transformation.h> 

/ {
    chosen {
        zmk,kscan = &default_kscan;
        zmk,matrix_transformation = &default_transform;
    };

    default_kscan: kscan {
        compatible = "zmk,kscan-gpio-matrix";
        label = "default_kscan";
        diode_direction = "col2row";

        row-gpios =
        }
}
